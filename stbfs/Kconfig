## stbfs/Kconfig
```kconfig
config STB_FS
	tristate "Stbfs stackable file system (EXPERIMENTAL)"
	help
	  Stbfs is a stackable file system which simply passes its
	  operations to the lower layer.  It is designed as a useful
	  template for developing or debugging other stackable file systems,
	  and more (see Documentation/filesystems/stbfs.txt).  See
	  <http://stbfs.filesystems.org/> for details.
```
